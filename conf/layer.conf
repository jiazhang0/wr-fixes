## conf/layer.conf
```bitbake
#
# Copyright (C) 2013 Wind River Systems, Inc.
#

# We have a conf and classes directory, add to BBPATH
BBPATH =. "${LAYERDIR}:"

# We have a packages directory, add to BBFILES
BBFILES += "${LAYERDIR}/recipes-*/*/*.bb \
	${LAYERDIR}/recipes-*/*/*.bbappend"

BBFILE_COLLECTIONS += "wr-fixes"
BBFILE_PATTERN_wr-fixes = "^${LAYERDIR}/"
BBFILE_PRIORITY_wr-fixes = "7"

# We have a pre-populated downloads directory, add to PREMIRRORS
PREMIRRORS_append = " \
     git://.*/.* file://${LAYERDIR}/downloads/ \n \
     svn://.*/.* file://${LAYERDIR}/downloads/ \n \
     ftp://.*/.* file://${LAYERDIR}/downloads/ \n \
     http://.*/.* file://${LAYERDIR}/downloads/ \n \
     https://.*/.* file://${LAYERDIR}/downloads/ \n"

# This should only be incremented on significant changes that will
# cause compatibility issues with other layers
LAYERVERSION_wr-fixes = "1"

LAYERDEPENDS_wr-fixes = "core"
```
